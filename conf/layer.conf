## conf/layer.conf
```bitbake
# We have a conf and classes directory, add to BBPATH
BBPATH .= ":${LAYERDIR}"

# We have recipes-* directories, add to BBFILES
BBFILES += " \
	${LAYERDIR}/recipes/*/*.bb \
	${LAYERDIR}/recipes/*/*.bbappend \
	${LAYERDIR}/recipes-*/*/*.bb \
	${LAYERDIR}/recipes-*/*/*.bbappend \
	"

BBFILE_COLLECTIONS += "meta-opendnp3"
BBFILE_PATTERN_meta-opendnp3 = "^${LAYERDIR}/"
BBFILE_PRIORITY_meta-opendnp3 = "6"
```
